## realms-devkit/Materializer-E33/components/flicker/Kconfig
```kconfig
# Flicker driver component (Materializer-E33)
# LED flicker for REALMS Part III materialization thesis.
# GPIO and frequency are passed at runtime via flicker_start(); no config here.
# Future: option to use external stimulus clock input (GPIO34/35).

menu "Flicker driver"

    # Placeholder for future options, e.g.:
    # config FLICKER_USE_EXTERNAL_CLOCK
    #     bool "Use external stimulus clock for timing"
    #     default n
    #     help
    #         When enabled, derive flicker rate from oscillator on GPIO34/35 instead of esp_timer.

endmenu
```

## realms-devkit/Materializer-E33/main/Kconfig.projbuild
```kconfig
# Materializer-E33 main component options (GPIO and flicker frequency)

menu "Materializer-E33"

    config MATERIALIZER_LED_GPIO
        int "LED GPIO number"
        default 2
        range 0 39
        help
            GPIO used for LED output (e.g. 2 for onboard LED on many dev boards).

    config MATERIALIZER_FLICKER_HZ
        int "Flicker frequency (Hz)"
        default 40
        range 1 120
        help
            LED flicker rate: 10 = Alpha band, 40 = Gamma band, 60-120 = flicker fusion.

endmenu
```

## realms-devkit/Materializer-E33/sdkconfig.defaults
```kconfig
# Materializer-E33 default config
CONFIG_IDF_TARGET="esp32"
CONFIG_MATERIALIZER_LED_GPIO=2
CONFIG_MATERIALIZER_FLICKER_HZ=40
```
